## test/tracepointtest/Kconfig
```kconfig
# Copyright (C) 2022 Huawei Device Co., Ltd.
# Licensed under the Apache License, Version 2.0 (the "License");
# you may not use this file except in compliance with the License.
# You may obtain a copy of the License at
#
#     http://www.apache.org/licenses/LICENSE-2.0
#
# Unless required by applicable law or agreed to in writing, software
# distributed under the License is distributed on an "AS IS" BASIS,
# WITHOUT WARRANTIES OR CONDITIONS OF ANY KIND, either express or implied.
# See the License for the specific language governing permissions and
# limitations under the License.
#
# Kconfig for tracepoint test
#

menu "tracepoint test"

source "drivers/tracepointtest/vendordommap_test/Kconfig"

source "drivers/tracepointtest/vendordomprotectpkey_test/Kconfig"

source "drivers/tracepointtest/tracepoint_test/Kconfig"

source "drivers/tracepointtest/vendoramlemmcpartition_test/Kconfig"

source "drivers/tracepointtest/vendorfakebootpartition_test/Kconfig"

endmenu
```

## test/tracepointtest/tracepoint_test/Kconfig
```kconfig
# SPDX-License-Identifier: GPL-2.0

config TRACEPOINT_TEST
  tristate "Test Tracepoint For Vendor Hooks"
  default m
  help
    Enable test tracepoint for vendor hooks
    Allow vendor modules to attach driver hooks defined via
    DECLARE_HOOK or DECLARE_RESTRICTED_HOOK
```

## test/tracepointtest/vendoramlemmcpartition_test/Kconfig
```kconfig
# SPDX-License-Identifier: GPL-2.0

config TRACEPOINT_AML_EMMC_PARTITION
  tristate "AML_EMMC_PARTITION Tracepoint For Vendor Hooks"
  depends on VENDOR_HOOKS
  default m
  help
    Enable aml emmc partition tracepoint for vendor hooks
    Allow vendor modules to attach driver hooks defined via
    DECLARE_HOOK or DECLARE_RESTRICTED_HOOK
```

## test/tracepointtest/vendordommap_test/Kconfig
```kconfig
# SPDX-License-Identifier: GPL-2.0

config TRACEPOINT_MMAP
  tristate "MMAP Tracepoint For Vendor Hooks"
  depends on VENDOR_HOOKS
  default m
  help
    Enable mmap tracepoint for vendor hooks
    Allow vendor modules to attach driver hooks defined via
    DECLARE_HOOK or DECLARE_RESTRICTED_HOOK
```

## test/tracepointtest/vendordomprotectpkey_test/Kconfig
```kconfig
# SPDX-License-Identifier: GPL-2.0

config TRACEPOINT_MPROTECT_PKEY
  tristate "MPROTECT_PKEY Tracepoint For Vendor Hooks"
  depends on VENDOR_HOOKS
  default m
  help
    Enable mprotect pkey tracepoint for vendor hooks
    Allow vendor modules to attach driver hooks defined via
    DECLARE_HOOK or DECLARE_RESTRICTED_HOOK
```

## test/tracepointtest/vendorfakebootpartition_test/Kconfig
```kconfig
# SPDX-License-Identifier: GPL-2.0

config TRACEPOINT_FAKE_BOOT_PARTITION
  tristate "FAKE_BOOT_PARTITION Tracepoint For Vendor Hooks"
  depends on VENDOR_HOOKS
  default m
  help
    Enable fake boot partition tracepoint for vendor hooks
    Allow vendor modules to attach driver hooks defined via
    DECLARE_HOOK or DECLARE_RESTRICTED_HOOK
```
